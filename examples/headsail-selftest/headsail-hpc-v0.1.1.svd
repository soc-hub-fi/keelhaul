# headsail register map
Vendor: tuni.fi; File version: 1.0
CPU: other r1p0, little endian, no MPU, no FPU, vendor SysTick, 2 interrupt priority bits
Registers are 32-bit, read-write, no defined reset value unless marked. A register's access mark holds for its fields unless they carry their own. Offsets are from the block's base; [hi:lo] are bit positions; lines under a group give offsets from that group.

## apb_uart0
Base 0x1FFF00000
Same registers: apb_uart1 0x1FFF01000
0x00 registers group
  0x00 RBR_THR_DLL 8-bit — RBR_THR_DLL is a multi-purpose register address. you can access 3 different registers using the same address. IF LCR[7] is 0 RBR and THR are accessable. OW DLL is accessable. RBR read only. Reads from rx fifo THR write only. Writes into a tx fifo DLL writes/reads into/from the 8 LSBs in the divisor
  0x01 IER_DLM 8-bit — IER_DLM is a multi-purpose register address. you can access 2 different registers using the same address. IF LCR[7] is 0 IER is accessable. O.W DLM is accessable. IER writes/reads into/from position IER => IER[2:0]: The interrupt enable bits. => xx1: Interrupt is raised when Received data available or trigger level reached in FIFO mode if non of these it checks Character timeout indication. => x10: Interrupt is raised when Transmitter holding register empty. => 100: Interrupt is raised when Overrun error, parity error, framing error or break interrupt. => other bits aren't used
  0x02 IIR_FCR 8-bit — IIR_FCR is a multi-purpose register address. you can access 2 different registers using the same address. However LCR[7] isn't needed in this case because one of them is only written and the other is only read. FCR (fifo control register) write only => FCR[1]: clears the rx fifo if high => FCR[2]: clears the tx fifo if high => FCR[7:6]: sets the trigger level =>00: trigger level is high when there is 1 element in the fifo =>01: trigger level is high when there are 4 elements in the fifo =>10: trigger level is high when there are 8 elements in the fifo =>11: trigger level is high when there are 14 elements in the fifo => other bits aren't used IIR (Interrupt Identification Register) read only
  0x03 LCR 8-bit — LCR is a register configures the main operation of the uart. It configures the width of the received data, stop bit, parity, and DLAB bit. => LCR[1:0]: configuration bits =>00: data is configured to be 5 bits =>01: data is configured to be 6 bits =>10: data is configured to be 7 bits =>11: data is configured to be 8 bits => LCR[2]: stop bit configuration =>0: 1 stop bit =>1: 1.5 stop bits for 5 bits data word OR 2 stop bits 6, 7 or 8 bits data word => LCR[3]: parity enable bit => LCR[7]: divisor latch access bit (DLAB) =>0: RBR, THR and IER accessible =>1: DLL and DLM accessible => other bits aren't used
  0x04 MCR 8-bit access not given — modem control (not used)
  0x05 LSR 8-bit ro — LSR is the line status register => LSR[0]: rx fifo data valid => LSR[2]: parity error from the rx fifo => LSR[5]: the tx fifo is empty => LSR[6]: shift register and tx fifo are empty => other bits aren't used
  0x06 MSR 8-bit access not given — modem status (not used)
  0x07 SCR 8-bit access not given — scratch (not used)

## apb_sw_irq
Base 0x1FFF06000
0x00 Apb_software_irq group
  0x00 read ro reset 0x0
    [3:0] read
  0x04 set wo reset 0x0
    [3:0] set
  0x08 clear wo reset 0x0
    [3:0] clear

## sdram_cfg
Base 0x1FFD00000
0x00 axi_lite_regs group
  0x00 ddr_refresh_ack reset 0x0
  0x04 ddr_init_done reset 0x0
  0x08 axi_enabled reset 0x1
  0x0C t_init reset 0x2710
  0x10 t_arf reset 0x17C
  0x14 t_mrd reset 0x2
  0x18 t_ras reset 0x3
  0x1C t_rc reset 0x4
  0x20 t_rcd reset 0x2
  0x24 t_rfc reset 0x4
  0x28 t_rp reset 0x2
  0x2C t_rrd reset 0x1
  0x30 t_wr reset 0x1
  0x34 t_wtr reset 0x2
  0x38 c_burst_len reset 0x1
  0x3C c_burst_cycles reset 0x1
  0x40 c_rd_lat reset 0x3
  0x44 c_wr_lat reset 0x1
  0x48 c_col_shift reset 0x1
  0x4C c_col_mask reset 0x3FF
  0x50 c_row_shift reset 0xD
  0x54 c_row_mask reset 0x3FFF
  0x58 c_bank_shift reset 0xB
  0x5C c_bank_mask reset 0x3
  0x60 c_offset reset 0x0
  0x64 c_start_addr reset 0x0
  0x68 c_end_addr reset 0xBFFFFFFF
  0x6C d_wrseparation reset 0x0
  0x70 d_wrlatcorr reset 0x0
