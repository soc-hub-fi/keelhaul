# component1: IP-XACT component
VLNV ::component1:1

## Address spaces and blocks
addressspace1: range , width 

## Registers
Registers are 32-bit, access not given, no defined reset value unless marked. A register's access mark holds for its fields unless they carry their own. Offsets are from the block's base; lines under a group give offsets from that group; [hi:lo] are bit positions; {n}, {i} and the like mark numbered series; 'fields as' and 'values as' point back to an identical list; <NAME> marks a mode.

## localmemorymap1.addressblock1
Base 0x00000000
0x00 register1
