# test register map
File version: 1.0
Registers are 32-bit, access not given, no defined reset value unless marked. A register's access mark holds for its fields unless they carry their own. Offsets are from the block's base; lines under a group give offsets from that group; [hi:lo] are bit positions; {n}, {i} and the like mark numbered series; 'fields as' and 'values as' point back to an identical list; <NAME> marks a mode.

## Memory map
0x00000000 peripheral1
0x00001000 peripheral2
0x00002000 peripheral3

## peripheral1
Base 0x00000000
0x00 register1

## peripheral2
Base 0x00001000
0x00 cluster1 group
0x100 cluster2 group
  0x00 register1
  0x40 register2
0x200 register1
0x300 register2

## peripheral3
Base 0x00002000
{0x0+0x40*i} register[{i}] (i=0..1)
